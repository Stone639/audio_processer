## sdkconfig.defaults
```kconfig
# Flash 大小
CONFIG_ESPTOOLPY_FLASHSIZE_16MB=y
CONFIG_ESPTOOLPY_FLASHSIZE="16MB"

# 自定义分区表
CONFIG_PARTITION_TABLE_CUSTOM=y
CONFIG_PARTITION_TABLE_CUSTOM_FILENAME="partitions.csv"
CONFIG_PARTITION_TABLE_FILENAME="partitions.csv"

# 启用 PSRAM
CONFIG_SPIRAM=y
CONFIG_SPIRAM_MODE_OCT=y
CONFIG_SPIRAM_SPEED_80M=y
CONFIG_SPIRAM_BOOT_INIT=y

# FreeRTOS 栈溢出检测
CONFIG_FREERTOS_CHECK_STACKOVERFLOW=y
CONFIG_FREERTOS_CHECK_STACKOVERFLOW_CANARY=y

# I2S ISR IRAM 安全模式（ISR 不访问 PSRAM）
CONFIG_I2S_ISR_IRAM_SAFE=y

# ISR 栈大小（默认 2048 可能不够）
CONFIG_ESP_INTERRUPT_LOOP_STACK_SIZE=4096

# 堆毒化（轻量级，free 时填充魔数，malloc 时检查，损坏时立即断言）
CONFIG_HEAP_POISONING_LIGHT=y
```
